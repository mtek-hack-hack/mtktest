vendor\InputMethod\zi\adaptation\include
plutommi\mmi\asyncevents\AsyncEventsInc
plutommi\mmi\Audio\AudioInc
plutommi\mmi\PROFILES\ProfilesInc
plutommi\mmi\callmanagement\CommonFiles\CommonInc
plutommi\mmi\callmanagement\outgoingcallmanagement\outgoinginc
plutommi\mmi\callmanagement\incomingcallmanagement\incominginc
plutommi\mmi\Calls\CallsInc
plutommi\mmi\DateTime\DateTimeInc
plutommi\mmi\debuglevels\debuglevelInc
plutommi\mmi\EMS\EmsInc
plutommi\mmi\framework\tasks\tasksinc
plutommi\mmi\framework\osl\oslInc
plutommi\mmi\framework\history\historyInc
plutommi\mmi\framework\EventHandling\EventsInc
plutommi\mmi\framework\history\historyInc
plutommi\mmi\framework\MemManager\MemManagerInc
plutommi\mmi\framework\NVRAMManager\NVRAMManagerInc
plutommi\mmi\framework\ThemeManager\ThemeManagerInc
plutommi\mmi\commonscreens\commonscreensInc
plutommi\mmi\FunAndGames\FunAndGamesInc
plutommi\mmi\gui\gui_inc
plutommi\mmi\gui\oem_inc
plutommi\mmi\gui\
plutommi\MMI\IdleScreen\IdleScreenInc
plutommi\MMI\IdleScreen\IdleScreenInc\DemoAppInc\
plutommi\mmi\inc
plutommi\mmi\inc\MenuID
plutommi\mmi\MainMenu\MainMenuInc
plutommi\mmi\Messages\MessagesInc
plutommi\mmi\miscframework\miscframeworkinc
plutommi\mmi\phonebook\PhonebookInc
plutommi\mmi\sat\satInc
plutommi\mmi\Setting\SettingInc
plutommi\mmi\CommonScreens\CommonScreensInc
plutommi\MtkApp\MtkAppInc
plutommi\MtkApp\EngineerMode\EngineerModeInc
plutommi\MtkApp\SoundRecorder\SoundRecorderInc
plutommi
plutommi\customer\customerinc
plutommi\MtkApp\Camera\CameraInc
plutommi\MtkApp\AudioPlayer\AudioPlayerInc
plutommi\MtkApp\FileMgr\FileMgrInc
plutommi\MtkApp\GDI\GDIInc
plutommi\MMI\EditorPen\EditorPenInc
