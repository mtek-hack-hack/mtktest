plutommi\MtkApp\MtkAppInc
plutommi\MtkApp\EngineerMode\EngineerModeInc
plutommi\MtkApp\Connectivity\ConnectivityInc
plutommi\MtkApp\Connectivity\ConnectivityInc\BtCommon
plutommi\MtkApp\Connectivity\ConnectivityInc\BtBchs
plutommi\MtkApp\Connectivity\ConnectivityInc\BtMtk
plutommi\MtkApp\Connectivity\ConnectivityInc\BtHandphone
plutommi\MtkApp\SoundRecorder\SoundRecorderInc
plutommi\MtkApp\AudioPlayer\AudioPlayerInc
plutommi\MtkApp\ABRepeater\ABRepeaterInc
plutommi\mmi\asyncevents\AsyncEventsInc
plutommi\mmi\Audio\AudioInc
plutommi\mmi\callmanagement\CommonFiles\CommonInc
plutommi\mmi\callmanagement\outgoingcallmanagement\outgoinginc
plutommi\mmi\callmanagement\incomingcallmanagement\incominginc
plutommi\mmi\Calls\CallsInc
plutommi\mmi\Connect\ConnectInc
plutommi\Customer\custresource
plutommi\mmi\DateTime\DateTimeInc
plutommi\mmi\debuglevels\debuglevelInc
plutommi\mmi\EMS\EmsInc
plutommi\mmi\FontData
plutommi\mmi\framework\tasks\tasksinc
plutommi\mmi\framework\osl\oslInc
plutommi\mmi\framework\history\historyInc
plutommi\mmi\framework\EventHandling\EventsInc
plutommi\mmi\framework\MemManager\MemManagerInc
plutommi\mmi\framework\NVRAMManager\NVRAMManagerInc
plutommi\mmi\framework\ThemeManager\ThemeManagerInc
plutommi\mmi\commonscreens\commonscreensInc
plutommi\mmi\FunAndGames\FunAndGamesInc
plutommi\mmi\gui\gui_inc
plutommi\mmi\gui\oem_inc
plutommi\mmi\gui\
plutommi\MMI\IdleScreen\IdleScreenInc
plutommi\MMI\IdleScreen\IdleScreenInc\DemoAppInc
plutommi\mmi\inc
plutommi\mmi\inc\ImgID
plutommi\mmi\inc\MenuID
plutommi\mmi\inc\StringID
plutommi\mmi\MainMenu\MainMenuInc
plutommi\mmi\Messages\MessagesInc
plutommi\MMI\Messages
plutommi\mmi\miscframework\miscframeworkinc
plutommi\mmi\phonebook\PhonebookInc
plutommi\mmi\profiles\ProfilesInc
plutommi\mmi\sat\satInc
plutommi\mmi\Setting\SettingInc
plutommi\mmi\SSC\SSCInc
plutommi\MMI\poweron\PoweronInc
plutommi\MMI\gpio\gpioInc
plutommi\MMI\DataAccount\DataAccountInc
plutommi\MMI\Framework\Osl\OslInc
plutommi\MMI\Help\HelpInc
plutommi\MMI\Organizer\OrganizerInc
plutommi\MMI\Extra\ExtraInc
plutommi\mmi\ATHandler\ATHandlerInc
t9\include
plutommi\mmi\NITZHandler\NITZInc
plutommi\MMI\Framework\FileSystem\FileSystemInc
MoDIS\FileSystem\FileSystemInc
fs\fat\include
plutommi\mmi\commonscreens\commonscreensInc
plutommi\mmi\CPHS\CPHSInc
plutommi\customer\customerinc
plutommi\MtkApp\FileMgr\FileMgrInc
plutommi\MtkApp\Camera\CameraInc
plutommi\MtkApp\BarcodeReader\BarcodeReaderInc
plutommi\MtkApp\Video\VideoInc
plutommi\MtkApp\GDI\GDIInc
plutommi\MtkApp\SVG\SVGInc
xmlp\include
plutommi\MtkApp\MDI\MDIInc
plutommi\MtkApp\mmiapi\include
interface\hwdrv
camera\include
wapadp\include
fmt\include
irda\inc
plutommi\MtkApp\vObjects\vObjectInc
plutommi\MtkApp\FMRadio\FMRadioInc
plutommi\MtkApp\FMScheduleRec\FMScheduleRecInc
plutommi\MMI\EmailApp\EmailAppInc
drm\include
plutommi\MtkApp\VRSD\VRSDInc
plutommi\MtkApp\VRSI\VRSIInc
plutommi\MtkApp\PhotoEditor\PhotoEditorInc
applib\misc\include
applib\mem\include
plutommi\MtkApp\BGSound\BGSoundInc
bchsadp\include
bchs\inc
bchs\drivers\inc
bchs\drivers\scheduler\inc
bchs\drivers\scheduler\inc\sched
bchs\drivers\core_stack\hci\inc
bchs\drivers\core_stack\inc
bchs\drivers\core_stack\hci\blue_stack\inc
bchs\profile_managers\inc
xmlp\include
plutommi\MtkApp\JavaAgency\JavaAgencyInc
plutommi\MMI\Dictionary\DictInc
j2me\interface
j2me\jal\include
plutommi\VendorApp\DevApp\DevAppInc
dp_engine\opengl
dp_engine\opengl\main
dp_engine\opengl\include
dp_engine\opengl\include\GLES
j2me\vm\IJET\adaptation\include
j2me\jal\include
m3g\include
dp_engine\m3d\include
plutommi\MtkApp\DLAgent\DLAgentInc
plutommi\MMI\UnifiedMessage\UnifiedMessageInc
plutommi\mmi\EbookReader\EbookInc
plutommi\mmi\EditorPen\EditorPenInc
plutommi\MtkApp\SWFlash\SWFlashInc
vendor\swflash\chaotex\adaptation\inc
plutommi\MtkApp\SyncML\SyncMLInc
plutommi\MMI\JataayuApp\JCommonModules\JProfileHandler\JProfileHandlerInc
media\stream\include\
btstack\inc
plutommi\mmi\VoIP\VoIPInc
plutommi\MtkApp\VideoEditor\VideoEditorInc
plutommi\MtkApp\DeviceManagement\DeviceManagementInc
ps\tftp\include
drv\include
plutommi\MtkApp\CentralConfigAgent\CentralConfigAgentInc
media\image\include\
plutommi\mtkapp\sfmp4\include
