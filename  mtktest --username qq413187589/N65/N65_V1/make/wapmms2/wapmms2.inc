3g324m\interface\inc
applib\inet\engine\include
applib\mem\include
applib\misc\include
applib\misc\include
btstack\inc
camera\include
dm\task\inc
dm\wrapper\inc
dp_engine\m3d\include
dp_engine\opengl
dp_engine\opengl\include
dp_engine\opengl\include\gles
dp_engine\opengl\main
drm\include
drv\include
fmt\include
fs\fat\include
interface\hwdrv
irda\inc
j2me\interface
j2me\jal\include
j2me\jal\include
j2me\vm\ijet\adaptation\include
m3g\include
media\image\include
media\rtp\inc
media\stream\include\
modis\filesystem\filesysteminc
plutommi\customer\customerinc
plutommi\customer\customize
plutommi\customer\custresource
plutommi\mmi\asyncevents\asynceventsinc
plutommi\mmi\athandler\athandlerinc
plutommi\mmi\audio\audioinc
plutommi\mmi\bidi\bidiinc
plutommi\mmi\browserapp\browser\browserinc
plutommi\mmi\browserapp\profile\profileinc
plutommi\mmi\browserapp\provisioning\provisioninginc
plutommi\mmi\browserapp\pushinbox\pushinboxinc
plutommi\mmi\callmanagement\commonfiles\commoninc
plutommi\mmi\callmanagement\incomingcallmanagement\incominginc
plutommi\mmi\callmanagement\outgoingcallmanagement\outgoinginc
plutommi\mmi\calls\callsinc
plutommi\mmi\chatapp\chatappinc
plutommi\mmi\commonscreens\commonscreensinc
plutommi\mmi\connect\connectinc
plutommi\mmi\cphs\cphsinc
plutommi\mmi\customerservice\customerserviceinc
plutommi\mmi\dataaccount\dataaccountinc
plutommi\mmi\datetime\datetimeinc
plutommi\mmi\debuglevels\debuglevelinc
plutommi\mmi\dictionary\dictinc
plutommi\mmi\ebookreader\ebookinc
plutommi\mmi\editorpen\editorpeninc
plutommi\mmi\emailapp\emailappinc
plutommi\mmi\ems\emsinc
plutommi\mmi\extra\extrainc
plutommi\mmi\fontdata
plutommi\mmi\framework\commonfiles\commoninc
plutommi\mmi\framework\eventhandling\eventsinc
plutommi\mmi\framework\filesystem\filesysteminc
plutommi\mmi\framework\history\historyinc
plutommi\mmi\framework\memmanager\memmanagerinc
plutommi\mmi\framework\nvrammanager\nvrammanagerinc
plutommi\mmi\framework\osl\oslinc
plutommi\mmi\framework\osl\oslinc
plutommi\mmi\framework\tasks\tasksinc
plutommi\mmi\framework\thememanager\thememanagerinc
plutommi\mmi\funandgames\funandgamesinc
plutommi\mmi\gpio\gpioinc
plutommi\mmi\gsmcallapplication\commonfiles\commoninc
plutommi\mmi\gsmcallapplication\incomingcallmanagement\incominginc
plutommi\mmi\gsmcallapplication\outgoingcallmanagement\outgoinginc
plutommi\mmi\gui\gui_inc
plutommi\mmi\gui\oem_inc
plutommi\mmi\help\helpinc
plutommi\mmi\idlescreen\idlescreeninc
plutommi\mmi\idlescreen\idlescreeninc\demoappinc
plutommi\mmi\imps\impsinc
plutommi\mmi\inc
plutommi\mmi\inc\imgid
plutommi\mmi\inc\menuid
plutommi\mmi\inc\stringid
plutommi\mmi\indiclanguages\indiclanguagesinc
plutommi\mmi\jataayuapp\jbrowsermmi\jbrowsermmiinc
plutommi\mmi\jataayuapp\jcommonmodules\jdrmhandler\jdrmhandlerinc
plutommi\mmi\jataayuapp\jcommonmodules\jprofilehandler\jprofilehandlerinc
plutommi\mmi\jataayuapp\jcommonmodules\jprovisioning\jprovisioninginc
plutommi\mmi\jataayuapp\jcommonmodules\jpushinbox\jpushinboxinc
plutommi\mmi\jataayuapp\jcommonmodules\jsr205\jsr205inc
plutommi\mmi\jataayuapp\jmmsmmi\jmmsmmiinc
plutommi\mmi\languages\thai\thaiinc
plutommi\mmi\mainmenu\mainmenuinc
plutommi\mmi\messages
plutommi\mmi\messages\messagesinc
plutommi\mmi\miscframework\miscframeworkinc
plutommi\mmi\mobileservice\mobileserviceinc
plutommi\mmi\nitzhandler\nitzinc
plutommi\mmi\organizer\organizerinc
plutommi\mmi\phonebook\phonebookinc
plutommi\mmi\poc\pocinc
plutommi\mmi\poweron\poweroninc
plutommi\mmi\profiles\profilesinc
plutommi\mmi\resource\inc
plutommi\mmi\sat\satinc
plutommi\mmi\setting\settinginc
plutommi\mmi\smartmessage\smartmessageinc
plutommi\mmi\ssc\sscinc
plutommi\mmi\ucm\ucminc
plutommi\mmi\unifiedcomposer\unifiedcomposerinc
plutommi\mmi\unifiedmessage\unifiedmessageinc
plutommi\mmi\unifiedmms\mmsapp\mmsappinc
plutommi\mmi\unifiedmms\mmsbgsr\mmsbgsrinc
plutommi\mmi\unifiedmms\mmscommon\mmscommoninc
plutommi\mmi\unifiedmms\mmscommon\mmscommoninc
plutommi\mmi\unifiedmms\mmsjsr\mmsjsrinc
plutommi\mmi\unifiedmms\mmsviewer\mmsviewerinc
plutommi\mmi\videocall\videocallinc
plutommi\mmi\voip\voipinc
plutommi\mtkapp\abrepeater\abrepeaterinc
plutommi\mtkapp\audioplayer\audioplayerinc
plutommi\mtkapp\avatar\avatarinc
plutommi\mtkapp\barcodereader\barcodereaderinc
plutommi\mtkapp\bgsound\bgsoundinc
plutommi\mtkapp\camera\camerainc
plutommi\mtkapp\centralconfigagent\centralconfigagentinc
plutommi\mtkapp\connectivity\connectivityinc
plutommi\mtkapp\connectivity\connectivityinc\btbchs
plutommi\mtkapp\connectivity\connectivityinc\btcommon
plutommi\mtkapp\connectivity\connectivityinc\bthandphone
plutommi\mtkapp\connectivity\connectivityinc\btmtk
plutommi\mtkapp\csbrowser\csbrowserinc
plutommi\mtkapp\devicemanagement\devicemanagementinc
plutommi\mtkapp\dlagent\dlagentinc
plutommi\mtkapp\dmuiapp\dmuiappinc
plutommi\mtkapp\engineermode\engineermodeinc
plutommi\mtkapp\filemgr\filemgrinc
plutommi\mtkapp\fmradio\fmradioinc
plutommi\mtkapp\fmschedulerec\fmschedulerecinc
plutommi\mtkapp\gdi\gdiinc
plutommi\mtkapp\javaagency\javaagencyinc
plutommi\mtkapp\mdi\mdiinc
plutommi\mtkapp\mmiapi\include
plutommi\mtkapp\mobiletvplayer\mobiletvplayerinc
plutommi\mtkapp\mtkappinc
plutommi\mtkapp\myfavorite\myfavoriteinc
plutommi\mtkapp\photoeditor\photoeditorinc
plutommi\mtkapp\pictbridge\pictbridgeinc
plutommi\mtkapp\rightsmgr\rightsmgrinc
plutommi\mtkapp\soundrecorder\soundrecorderinc
plutommi\mtkapp\svg\svginc
plutommi\mtkapp\swflash\swflashinc
plutommi\mtkapp\syncml\syncmlinc
plutommi\mtkapp\video\videoinc
plutommi\mtkapp\videoeditor\videoeditorinc
plutommi\mtkapp\vobjects\vobjectinc
plutommi\mtkapp\vrsd\vrsdinc
plutommi\mtkapp\vrsi\vrsiinc
plutommi\vendorapp\devapp\devappinc
ps\interfaces\local_inc
ps\tftp\include
t9\include
usb\include
vendor\dict\gv\adaptation\inc
vendor\dict\motech\adaptation\inc
vendor\dict\trilogy\adaptation\inc
vendor\game_engine\brogent\adaptation
vendor\game_engine\brogent\game
vendor\game_engine\intergrafx\adaptation
vendor\game_engine\intergrafx\game
vendor\inputmethod\cstar\adaptation\include
vendor\inputmethod\t9\adaptation\include
vendor\inputmethod\zi\adaptation\include
vendor\langlearn\app\inc
vendor\swflash\chaotex\adaptation\inc
vendor\swflash\chaotex\v1_official\inc
vendor\swflash\neomtel\adaptation\inc
vendor\wap\jataayu4\adaptation\config\srcs\include
vendor\wap\jataayu4\adaptation\include
vendor\wap\jataayu4\adaptation\mmi\srcs\include
vendor\wap\jataayu4\v1_official\browser\cache\srcs\include
vendor\wap\jataayu4\v1_official\browser\cookie\srcs\include
vendor\wap\jataayu4\v1_official\browser\downloadclient\srcs\include
vendor\wap\jataayu4\v1_official\browser\fsm\srcs\include
vendor\wap\jataayu4\v1_official\browser\include
vendor\wap\jataayu4\v1_official\browser\layout\srcs\include
vendor\wap\jataayu4\v1_official\browser\pushhandler\srcs\include
vendor\wap\jataayu4\v1_official\browser\wmlscript\srcs\include
vendor\wap\jataayu4\v1_official\common\charset\srcs\include
vendor\wap\jataayu4\v1_official\common\commonutils\srcs\include
vendor\wap\jataayu4\v1_official\common\communicator2\srcs\include
vendor\wap\jataayu4\v1_official\common\css2\srcs\include
vendor\wap\jataayu4\v1_official\common\css\srcs\include
vendor\wap\jataayu4\v1_official\common\deflate\srcs\include
vendor\wap\jataayu4\v1_official\common\hashalg\srcs\include
vendor\wap\jataayu4\v1_official\common\include
vendor\wap\jataayu4\v1_official\common\memutils\srcs\include
vendor\wap\jataayu4\v1_official\common\wapgsm\srcs\include
vendor\wap\jataayu4\v1_official\common\wbxml\srcs\include
vendor\wap\jataayu4\v1_official\common\xml\srcs\include
vendor\wap\jataayu4\v1_official\mms\compose\srcs\include
vendor\wap\jataayu4\v1_official\mms\include
vendor\wap\jataayu4\v1_official\mms\messagecontroller\srcs\include
vendor\wap\jataayu4\v1_official\mms\mm1\srcs\include
vendor\wap\jataayu4\v1_official\mms\presentationcontroller\srcs\include
vendor\wap\jataayu4\v1_official\mms\smil\srcs\include
vendor\wap\jataayu4\v1_official\mms\store\srcs\include
vendor\wap\jataayu4\v1_official\mms\view\srcs\include
vendor\wap\jataayu4\v1_official\transport2\http\srcs\include
vendor\wap\jataayu4\v1_official\transport2\http\srcs\include\ssl
vendor\wap\jataayu4\v1_official\transport2\http\srcs\include\tls
vendor\wap\jataayu4\v1_official\transport2\httppush\srcs\include
vendor\wap\jataayu4\v1_official\transport2\httputils\srcs\include
vendor\wap\jataayu4\v1_official\transport2\include
vendor\wap\jataayu4\v1_official\transport2\sia\srcs\include
vendor\wap\jataayu4\v1_official\transport2\transporttask\srcs\include
vendor\wap\jataayu4\v1_official\transport2\wapstack\srcs\include
vendor\wap\jataayu4\v1_official\transport2\wsputils\srcs\include
vendor\wap\obigo_q05a\adaptation\integration\owl\include
vendor\wap\obigo_q05a\adaptation\modules\bam\include
verno
vendor\wap\obigo_Q03C\v1_official\modules\bra\config
vendor\wap\obigo_Q03C\v1_official\modules\bra\refsrc
vendor\wap\obigo_Q03C\v1_official\modules\bra\source
vendor\wap\obigo_Q03C\v1_official\modules\mea\intgr
vendor\wap\obigo_Q03C\v1_official\msf\msf_lib\config
vendor\wap\obigo_Q03C\v1_official\msf\msf_lib\export
vendor\wap\obigo_Q03C\v1_official\msf\msf_lib\intgr
wapadp\include
vendor\wap\obigo_Q03C\adaptation\modules\mma\include
vendor\wap\obigo_Q03C\adaptation\msf_ui\include
xmlp\include

custom\mercury\mercury_master\inc
custom\mercury\mercury_slave\inc
vendor\mercury_master\inc
vendor\mercury_master\inc\master_sdk_inc
vendor\mercury_master\inc\adapter_inc
vendor\mercury_gemini\ADL\inc
vendor\mercury_gemini\ADU\inc
vendor\mercury_gemini\common\inc
vendor\mercury_gemini\PFALL\inc
vendor\mercury_gemini\PFALU\inc
plutommi\mmi\AnalogTVApp\AnalogTVAppInc

plutommi\mmi\asyncevents\AsyncEventsInc
plutommi\mmi\Audio\AudioInc
plutommi\mmi\callmanagement\CommonFiles\CommonInc
plutommi\mmi\callmanagement\outgoingcallmanagement\outgoinginc
plutommi\mmi\callmanagement\incomingcallmanagement\incominginc
plutommi\mmi\Calls\CallsInc
plutommi\MMI\ChatApp\ChatAppInc
plutommi\mmi\Connect\ConnectInc
plutommi\Customer\custresource
plutommi\mmi\DateTime\DateTimeInc
plutommi\mmi\debuglevels\debuglevelInc
plutommi\mmi\EMS\EmsInc
plutommi\mmi\FontData
plutommi\mmi\framework\tasks\tasksinc
plutommi\mmi\framework\osl\oslInc
plutommi\mmi\framework\history\historyInc
plutommi\mmi\framework\EventHandling\EventsInc
plutommi\mmi\framework\MemManager\MemManagerInc
plutommi\mmi\framework\NVRAMManager\NVRAMManagerInc
plutommi\mmi\FunAndGames\FunAndGamesInc
plutommi\mmi\gui\gui_inc
plutommi\MMI\IdleScreen\IdleScreenInc
plutommi\MMI\IdleScreen\IdleScreenInc\DemoAppInc
plutommi\mmi\inc
plutommi\mmi\inc\ImgID
plutommi\mmi\inc\MenuID
plutommi\mmi\inc\StringID
plutommi\mmi\MainMenu\MainMenuInc
plutommi\mmi\Messages\MessagesInc
plutommi\MMI\Messages
plutommi\mmi\miscframework\miscframeworkinc
plutommi\mmi\phonebook\PhonebookInc
plutommi\mmi\profiles\ProfilesInc
plutommi\mmi\sat\satInc
plutommi\mmi\Setting\SettingInc
plutommi\MMI\Shortcuts\ShortcutsInc
plutommi\mmi\SSC\SSCInc
plutommi\MtkApp\MtkAppInc
plutommi\MtkApp\EngineerMode\EngineerModeInc
plutommi\MtkApp\SoundRecorder\SoundRecorderInc
plutommi\MtkApp\AudioPlayer\AudioPlayerInc
plutommi\MtkApp\FMRadio\FMRadioInc
plutommi\MtkApp\ExtDevice\ExtDeviceInc
plutommi\MMI\poweron\PoweronInc
plutommi\MMI\gpio\gpioInc
plutommi\MMI\DataAccount\DataAccountInc
plutommi\MMI\Framework\Osl\OslInc
plutommi\MMI\Help\HelpInc
plutommi\MMI\Alarm\AlarmInc
plutommi\MMI\Organizer\OrganizerInc
plutommi\mmi\ATHandler\ATHandlerInc
plutommi\mmi\Calendar\CalendarInc
plutommi\mmi\ToDoList\ToDoListInc
t9\include
zi\include
kal\include
kal\efs\include
itap\include
plutommi\mmi\NITZHandler\NITZInc
plutommi\MMI\Framework\FileSystem\FileSystemInc
plutommi\mmi\commonscreens\commonscreensInc
plutommi\mmi\CPHS\CPHSInc
plutommi\Customer\CustomerInc
plutommi\Customer\Customize
verno
plutommi\MtkApp\FileMgr\FileMgrInc
plutommi\MtkApp\Camera\CameraInc
plutommi\MtkApp\Video\VideoInc
plutommi\MtkApp\GDI\GDIInc
plutommi\MtkApp\MDI\MDIInc
plutommi\MtkApp\mmiapi\include
plutommi\MtkApp\vObjects\vObjectInc
fmt\include
plutommi\MMI\Stopwatch\StopwatchInc
plutommi\MMI\EmailApp\EmailAppInc
wapadp\include
plutommi\MtkApp\Mjpeg\MjpegInc

plutommi\mmi\WapMms2\WapInc
plutommi\mmi\WapMms2\MmsInc
plutommi\mmi\WapMms2\WapAdp

cmswapmmslib\inc
cmswapmmslib\BrowserLib\brwtest
cmswapmmslib\BrowserLib\touchpanel
cmswapmmslib\BrowserLib\security
cmswapmmslib\BrowserLib\security
cmswapmmslib\BrowserLib\xmlparse
cmswapmmslib\BrowserLib\xmlparse
cmswapmmslib\BrowserLib\WTAI
cmswapmmslib\BrowserLib\binscript
cmswapmmslib\BrowserLib\textscript
cmswapmmslib\BrowserLib\BiTree
cmswapmmslib\BrowserLib\css
cmswapmmslib\BrowserLib\core
cmswapmmslib\CommonLib\cmsword
cmswapmmslib\CommonLib\drm
cmswapmmslib\CommonLib\gifwbmp
cmswapmmslib\CommonLib\http
cmswapmmslib\CommonLib\jpeg
cmswapmmslib\CommonLib\libtls
cmswapmmslib\CommonLib\libwtls
cmswapmmslib\CommonLib\net
cmswapmmslib\CommonLib\png
cmswapmmslib\CommonLib\provisioning
cmswapmmslib\CommonLib\sys
cmswapmmslib\CommonLib\time
cmswapmmslib\CommonLib\url
cmswapmmslib\CommonLib\vwlibbase
cmswapmmslib\CommonLib\wap12
cmswapmmslib\CommonLib\zlib
cmswapmmslib\MmsLib


cmswapmmslib\openssllib\crypto
cmswapmmslib\openssllib
cmswapmmslib\openssllib\include

applib\misc\include
