wapadp\include
vendor\wap\obigo_Q03C\adaptation\integration\include
vendor\wap\obigo_Q03C\adaptation\modules\wps\include
vendor\wap\obigo_Q03C\adaptation\modules\mmc\intgr
vendor\wap\obigo_Q03C\adaptation\modules\mmc\source
vendor\wap\obigo_Q03C\adaptation\msf_ui\include
vendor\wap\obigo_Q03C\v1_official\msf\msf_lib\config
vendor\wap\obigo_Q03C\v1_official\msf\msf_lib\intgr
vendor\wap\obigo_Q03C\v1_official\msf\msf_lib\export
vendor\wap\obigo_Q03C\v1_official\msf\msf_mgr\intgr
vendor\wap\obigo_Q03C\v1_official\modules\BRA\config
vendor\wap\obigo_Q03C\v1_official\modules\BRA\intgr
vendor\wap\obigo_Q03C\v1_official\modules\BRA\source
vendor\wap\obigo_Q03C\v1_official\modules\BRA\refsrc
vendor\wap\obigo_Q03C\v1_official\modules\BRA\export
vendor\wap\obigo_Q03C\v1_official\modules\BRS\config
vendor\wap\obigo_Q03C\v1_official\modules\BRS\intgr
vendor\wap\obigo_Q03C\v1_official\modules\BRS\export
vendor\wap\obigo_Q03C\v1_official\modules\IBS\config
vendor\wap\obigo_Q03C\v1_official\modules\IBS\intgr
vendor\wap\obigo_Q03C\v1_official\modules\JAS\config
vendor\wap\obigo_Q03C\v1_official\modules\JAS\intgr
vendor\wap\obigo_Q03C\v1_official\modules\MEA\config
vendor\wap\obigo_Q03C\v1_official\modules\MEA\intgr
vendor\wap\obigo_Q03C\v1_official\modules\MEA\source
vendor\wap\obigo_Q03C\v1_official\modules\MMS\config
vendor\wap\obigo_Q03C\v1_official\modules\MMS\intgr
vendor\wap\obigo_Q03C\v1_official\modules\MMS\export
vendor\wap\obigo_Q03C\v1_official\modules\MMS\source
vendor\wap\obigo_Q03C\v1_official\modules\MMS\refsrc
vendor\wap\obigo_Q03C\v1_official\modules\PHS\config
vendor\wap\obigo_Q03C\v1_official\modules\PHS\intgr
vendor\wap\obigo_Q03C\v1_official\modules\PRS\config
vendor\wap\obigo_Q03C\v1_official\modules\PRS\intgr
vendor\wap\obigo_Q03C\v1_official\modules\SEC\config
vendor\wap\obigo_Q03C\v1_official\modules\SEC\export
vendor\wap\obigo_Q03C\v1_official\modules\SEC\intgr
vendor\wap\obigo_Q03C\v1_official\modules\SEC\source
vendor\wap\obigo_Q03C\v1_official\modules\SLS\config
vendor\wap\obigo_Q03C\v1_official\modules\SLS\intgr
vendor\wap\obigo_Q03C\v1_official\modules\SMA\config
vendor\wap\obigo_Q03C\v1_official\modules\SMA\intgr
vendor\wap\obigo_Q03C\v1_official\modules\STK\config
vendor\wap\obigo_Q03C\v1_official\modules\STK\intgr
vendor\wap\obigo_Q03C\v1_official\modules\STK\export
vendor\wap\obigo_Q03C\v1_official\modules\UIS\config
vendor\wap\obigo_Q03C\v1_official\modules\UIS\intgr
vendor\wap\obigo_Q03C\v1_official\modules\UIA\config
vendor\wap\obigo_Q03C\v1_official\modules\UIA\intgr
applib\misc\include
applib\mem\include
Plutommi\mmi\Inc
plutommi\mmi\inc\ImgID
plutommi\mmi\inc\MenuID
plutommi\mmi\inc\StringID
plutommi\mmi\commonscreens\commonscreensinc
Plutommi\mmi\Framework\CommonFiles\CommonInc
plutommi\mmi\framework\NVRAMManager\NVRAMManagerInc
plutommi\mmi\framework\ThemeManager\ThemeManagerInc
Plutommi\mmi\Framework\Osl\OslInc
Plutommi\mmi\debuglevels\DebugLevelInc
Plutommi\mmi\Framework\EventHandling\EventsInc
Plutommi\mmi\Framework\Tasks\TasksInc
Plutommi\mmi\Framework\history\historyinc
plutommi\MMI\Framework\MemManager\MemManagerInc
Plutommi\mmi\Framework\FileSystem\FileSystemInc
MoDIS\FileSystem\FileSystemInc
Plutommi\mmi\gui\gui_Inc
plutommi\mmi\gui\oem_inc
Plutommi\mmi\DateTime\DateTimeInc
Plutommi\mmi\MiscFramework\MiscFrameworkInc
plutommi\mmi\PROFILES\ProfilesInc
plutommi\mmi\phonebook\phonebookinc\
plutommi\mmi\Organizer\OrganizerInc\
plutommi\mmi\Framework\NVRAMManager\NVRAMManagerInc
plutommi\mmi\gpio\gpioInc\
plutommi\mmi\CallManagement\CommonFiles\CommonInc
plutommi\mmi\CallManagement\IncomingCallManagement\IncomingInc
plutommi\mmi\CallManagement\OutgoingCallManagement\OutgoingInc
plutommi\mmi\GSMCallApplication\CommonFiles\CommonInc
plutommi\mmi\GSMCallApplication\outgoingcallmanagement\outgoinginc
plutommi\mmi\GSMCallApplication\incomingcallmanagement\incominginc
plutommi\mmi\messages\messagesInc\
Plutommi\mmi\
plutommi\MMI\IdleScreen\IdleScreenInc
plutommi\MtkApp\MtkAppInc
plutommi\MtkApp\EngineerMode\EngineerModeInc
plutommi\MtkApp\SoundRecorder\SoundRecorderInc
plutommi\mmi\FunAndGames\FunAndGamesInc
plutommi\mmi\Framework\ThemeManager\ThemeManagerInc
plutommi\mmi\audio\audioinc
plutommi\mmi\sat\satInc
plutommi\customer\customerInc
plutommi\MtkApp\GDI\GDIInc
plutommi\MtkApp\MDI\MDIInc
plutommi\MtkApp\Camera\CameraInc
plutommi\MtkApp\AudioPlayer\AudioPlayerInc
plutommi\MtkApp\FileMgr\FileMgrInc
plutommi\MtkApp\mmiapi\include
fmt\include
plutommi\MtkApp\JavaAgency\JavaAgencyInc
drm\include
j2me\interface
j2me\jal\include
plutommi\MtkApp\Connectivity\ConnectivityInc

vendor\mercury_master\inc
vendor\mercury_master\inc\master_sdk_inc
vendor\mercury_master\inc\adapter_inc
custom\mercury\mercury_master\inc
custom\mercury\mercury_slave\inc

