wapadp\include
vendor\wap\obigo_Q03C\adaptation\integration\include
vendor\wap\obigo_Q03C\adaptation\modules\mmc\intgr
vendor\wap\obigo_Q03C\adaptation\modules\wps\include
vendor\wap\obigo_Q03C\v1_official\msf\msf_lib\config
vendor\wap\obigo_Q03C\v1_official\msf\msf_lib\refsrc
vendor\wap\obigo_Q03C\v1_official\msf\msf_lib\export
vendor\wap\obigo_Q03C\v1_official\msf\msf_lib\intgr
vendor\wap\obigo_Q03C\v1_official\msf\msf_mgr\refsrc
vendor\wap\obigo_Q03C\v1_official\msf\msf_mgr\intgr
vendor\wap\obigo_Q03C\v1_official\msf\msf_mgr\source
vendor\wap\obigo_Q03C\v1_official\modules\BRA\config
vendor\wap\obigo_Q03C\v1_official\modules\BRA\intgr
vendor\wap\obigo_Q03C\v1_official\modules\BRA\source
vendor\wap\obigo_Q03C\v1_official\modules\BRA\refsrc
vendor\wap\obigo_Q03C\v1_official\modules\BRA\export
vendor\wap\obigo_Q03C\v1_official\modules\BRS\config
vendor\wap\obigo_Q03C\v1_official\modules\BRS\refsrc
vendor\wap\obigo_Q03C\v1_official\modules\BRS\export
vendor\wap\obigo_Q03C\v1_official\modules\BRS\intgr
vendor\wap\obigo_Q03C\v1_official\modules\BRS\source
vendor\wap\obigo_Q03C\v1_official\modules\MEA\config
vendor\wap\obigo_Q03C\v1_official\modules\MEA\intgr
vendor\wap\obigo_Q03C\v1_official\modules\MEA\refsrc
vendor\wap\obigo_Q03C\v1_official\modules\MEA\source
vendor\wap\obigo_Q03C\v1_official\modules\MMS\config
vendor\wap\obigo_Q03C\v1_official\modules\MMS\refsrc
vendor\wap\obigo_Q03C\v1_official\modules\MMS\intgr
vendor\wap\obigo_Q03C\v1_official\modules\MMS\source
vendor\wap\obigo_Q03C\v1_official\modules\MMS\export
vendor\wap\obigo_Q03C\v1_official\modules\PHS\config
vendor\wap\obigo_Q03C\v1_official\modules\PHS\refsrc
vendor\wap\obigo_Q03C\v1_official\modules\PHS\intgr
vendor\wap\obigo_Q03C\v1_official\modules\PHS\source
vendor\wap\obigo_Q03C\v1_official\modules\PRS\config
vendor\wap\obigo_Q03C\v1_official\modules\PRS\refsrc
vendor\wap\obigo_Q03C\v1_official\modules\PRS\refsrc\hmac
vendor\wap\obigo_Q03C\v1_official\modules\PRS\source
vendor\wap\obigo_Q03C\v1_official\modules\PRS\export
vendor\wap\obigo_Q03C\v1_official\modules\PRS\intgr
vendor\wap\obigo_Q03C\v1_official\modules\SLS\config
vendor\wap\obigo_Q03C\v1_official\modules\SLS\export
vendor\wap\obigo_Q03C\v1_official\modules\SLS\intgr
vendor\wap\obigo_Q03C\v1_official\modules\SMA\config
vendor\wap\obigo_Q03C\v1_official\modules\SMA\intgr
vendor\wap\obigo_Q03C\v1_official\modules\SMA\refsrc
vendor\wap\obigo_Q03C\v1_official\modules\SMA\export
vendor\wap\obigo_Q03C\v1_official\modules\SMA\source
vendor\wap\obigo_Q03C\v1_official\modules\STK\config
vendor\wap\obigo_Q03C\v1_official\modules\STK\refsrc
vendor\wap\obigo_Q03C\v1_official\modules\STK\export
vendor\wap\obigo_Q03C\v1_official\modules\STK\intgr
vendor\wap\obigo_Q03C\v1_official\modules\UIS\config
vendor\wap\obigo_Q03C\v1_official\modules\UIS\refsrc
vendor\wap\obigo_Q03C\v1_official\modules\UIS\export
vendor\wap\obigo_Q03C\v1_official\modules\UIS\intgr
Plutommi\mmi\Inc
plutommi\mmi\inc\ImgID
plutommi\mmi\inc\MenuID
plutommi\mmi\inc\StringID
plutommi\mmi\commonscreens\commonscreensinc
plutommi\mmi\framework\MemManager\MemManagerInc
Plutommi\mmi\Framework\Osl\OslInc
Plutommi\mmi\debuglevels\DebugLevelInc
Plutommi\mmi\Framework\EventHandling\EventsInc
Plutommi\mmi\Framework\Tasks\TasksInc
Plutommi\mmi\Framework\history\historyinc
Plutommi\mmi\Framework\FileSystem\FileSystemInc
Plutommi\mmi\gui\gui_Inc
plutommi\mmi\gui\oem_inc
Plutommi\mmi\DateTime\DateTimeInc
Plutommi\mmi\MiscFramework\MiscFrameworkInc
plutommi\mmi\PROFILES\ProfilesInc
plutommi\mmi\phonebook\phonebookinc\
plutommi\mmi\Organizer\OrganizerInc\
plutommi\mmi\gpio\gpioInc\
plutommi\mmi\messages\messagesInc\
Plutommi\mmi\
plutommi\MMI\IdleScreen\IdleScreenInc
plutommi\MtkApp\MtkAppInc
plutommi\MtkApp\EngineerMode\EngineerModeInc
plutommi\MtkApp\SoundRecorder\SoundRecorderInc
plutommi\mmi\FunAndGames\FunAndGamesInc
plutommi\mmi\audio\audioinc
plutommi\mmi\sat\satInc
plutommi\customer\customerInc
plutommi\MtkApp\GDI\GDIInc
plutommi\MtkApp\MDI\MDIInc
plutommi\MtkApp\Camera\CameraInc
plutommi\MtkApp\AudioPlayer\AudioPlayerInc
plutommi\MtkApp\FileMgr\FileMgrInc
plutommi\MtkApp\mmiapi\include
applib\misc\include
fmt\include

vendor\mercury_master\inc
vendor\mercury_master\inc\master_sdk_inc
vendor\mercury_master\inc\adapter_inc
custom\mercury\mercury_master\inc
custom\mercury\mercury_slave\inc
