applib\misc\include\
applib\mem\include\
drv\include\
dp_engine\che\
plutommi\mmi\inc\
plutommi\mmi\framework\commonfiles\commoninc
plutommi\MMI\Framework\NVRAMManager\NVRAMManagerInc\
vendor\game_engine\brogent\adaptation\
plutommi\mtkapp\barcodereader\barcodereaderinc\
plutommi\mtkapp\GDI\GDIINC\
vendor\game_engine\intergrafx\adaptation\
plutommi\MtkApp\VideoEditor\VideoEditorInc\
plutommi\MtkApp\Avatar\AvatarInc\
vendor\wap\jataayu4\adaptation\include\
plutommi\MtkApp\Camera\CameraInc\
plutommi\MtkApp\MDI\MDIInc\
plutommi\mmi\UnifiedMMS\MMSViewer\MMSViewerInc\
custom\common\pluto_mmi\
custom\common\
plutommi\MMI\BrowserApp\Browser\BrowserInc
plutommi\MMI\Framework\tasks\tasksinc\
plutommi\MMI\Framework\memmanager\memmanagerinc\
plutommi\MMI\debuglevels\debuglevelinc\
plutommi\mtkapp\mmiapi\include\
plutommi\mtkapp\mtkappinc\
vendor\langlearn\app\inc\
plutommi\MtkApp\MobileTVPlayer\MobileTVPlayerInc\
plutommi\MtkApp\PhotoEditor\PhotoEditorInc\
plutommi\mtkapp\ABRepeater\ABRepeaterInc\
media\common\include\
media\image\include\
vendor\gis\mapbar\mmi\inc\
