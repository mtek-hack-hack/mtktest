drv\include
media\common\include
media\audio\include
media\video\include
media\camera\include
media\image\include
media\webcam\include
media\tvout\include
media\mtv\include
image_codec\sw_jpeg_codec\include
l1audio
drm\include
plutommi\mtkapp\mtkappinc
plutommi\mtkapp\gdi\gdiinc
plutommi\mmi\inc
media\rtp\inc
media\stream\include
applib\inet\engine\include
sst\include
vendor\tdmb\cyberlink\inc
vendor\tdmb\cyberlink\adaptation\inc
tdmb\hostdrv\inc
applib\misc\include
ps\l4\uem\include
ps\crypto\sb51\husw\src\huswadap\include
ps\crypto\sb51\husw\src\common\include
ps\crypto\sb51\husw\src\aes\include
ps\crypto\sb51\husw\src\huapi\include
ps\crypto\sb51\husw\src\rng\include
ps\crypto\sb51\husw\src\sha1\include
ps\crypto\sb51\husw\src\huctx\include
ps\crypto\sb51\husw\src\eca\include
ps\crypto\sb51\husw\src\ff\include
ps\crypto\sb51\husw\src\zmod\include
ps\crypto\sb51\husw\src\huxapi\include
ps\crypto\sb51\husw\src\huutil\include
ps\crypto\sb51\husw\src\seed\include
ps\crypto\sb51\husw\src\hudefaultmem\include
media\vcall\include
3g324m\appl\inc
3g324m\interface\inc
