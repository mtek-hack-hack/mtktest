plutommi\mmi\asyncevents\AsyncEventsInc
plutommi\mmi\Audio\AudioInc
plutommi\mmi\callmanagement\CommonFiles\CommonInc
plutommi\mmi\callmanagement\outgoingcallmanagement\outgoinginc
plutommi\mmi\callmanagement\incomingcallmanagement\incominginc
plutommi\mmi\GSMCallApplication\CommonFiles\CommonInc
plutommi\mmi\GSMCallApplication\outgoingcallmanagement\outgoinginc
plutommi\mmi\GSMCallApplication\incomingcallmanagement\incominginc
plutommi\mmi\Calls\CallsInc
plutommi\mmi\Connect\ConnectInc
plutommi\Customer\custresource
plutommi\mmi\DateTime\DateTimeInc
plutommi\mmi\debuglevels\debuglevelInc
plutommi\mmi\EMS\EmsInc
plutommi\mmi\FontData
plutommi\mmi\framework\commonfiles\commoninc
plutommi\mmi\framework\MemManager\MemManagerInc
plutommi\mmi\framework\tasks\tasksinc
plutommi\mmi\framework\osl\oslInc
plutommi\mmi\framework\history\historyInc
plutommi\mmi\framework\EventHandling\EventsInc
plutommi\mmi\framework\NVRAMManager\NVRAMManagerInc
plutommi\mmi\FunAndGames\FunAndGamesInc
plutommi\mmi\gui\gui_inc
plutommi\mmi\gui\oem_inc
plutommi\MMI\IdleScreen\IdleScreenInc
plutommi\MMI\IdleScreen\IdleScreenInc\DemoAppInc
plutommi\mmi\inc
plutommi\mmi\inc\ImgID
plutommi\mmi\inc\MenuID
plutommi\mmi\inc\StringID
plutommi\mmi\MainMenu\MainMenuInc
plutommi\mmi\Messages\MessagesInc
plutommi\MMI\Messages
plutommi\mmi\miscframework\miscframeworkinc
plutommi\mmi\phonebook\PhonebookInc
plutommi\mmi\profiles\ProfilesInc
plutommi\mmi\sat\satInc
plutommi\mmi\Setting\SettingInc
plutommi\mmi\SSC\SSCInc
plutommi\MtkApp\MtkAppInc
plutommi\MtkApp\EngineerMode\EngineerModeInc
plutommi\MtkApp\SoundRecorder\SoundRecorderInc
plutommi\MtkApp\AudioPlayer\AudioPlayerInc
plutommi\MtkApp\ABRepeater\ABRepeaterInc
plutommi\mtkapp\CSBrowser\CSBrowserInc
plutommi\MtkApp\FMRadio\FMRadioInc
plutommi\MtkApp\FMScheduleRec\FMScheduleRecInc
plutommi\MtkApp\FileMgr\FileMgrInc
plutommi\MMI\poweron\PoweronInc
plutommi\MMI\gpio\gpioInc
plutommi\MMI\DataAccount\DataAccountInc
plutommi\MMI\Framework\Osl\OslInc
plutommi\MMI\Help\HelpInc
plutommi\MMI\Extra\ExtraInc
plutommi\MMI\Organizer\OrganizerInc
plutommi\mmi\ATHandler\ATHandlerInc
t9\include
plutommi\mmi\NITZHandler\NITZInc
plutommi\MMI\Framework\FileSystem\FileSystemInc
plutommi\mmi\commonscreens\commonscreensInc
plutommi\mmi\CPHS\CPHSInc
plutommi\Customer\CustomerInc
plutommi\Customer\Customize
plutommi\MtkApp\Camera\CameraInc
plutommi\MtkApp\Video\VideoInc
plutommi\MtkApp\GDI\GDIInc
fmt\include
plutommi\MtkApp\vObjects\vObjectInc
plutommi\MtkApp\VRSD\VRSDInc
plutommi\MtkApp\PhotoEditor\PhotoEditorInc
verno
plutommi\MtkApp\JavaAgency\JavaAgencyInc
plutommi\mmi\EbookReader\EbookInc
plutommi\mmi\Dictionary\DictInc
plutommi\MMI\VoIP\VoIPInc
plutommi\MMI\UCM\UCMInc
plutommi\mmi\JataayuApp\JMMSMMI\JMMSMMIInc
plutommi\MMI\JataayuApp\JBrowserMMI\JBrowserMMIInc
plutommi\mmi\JataayuApp\JCommonModules\JPushInbox\JPushInboxInc
plutommi\MMI\JataayuApp\JCommonModules\JProfileHandler\JProfileHandlerInc
vendor\wap\jataayu4\adaptation\mmi\srcs\include
plutommi\MMI\UnifiedMessage\UnifiedMessageInc
plutommi\Mtkapp\DLAgent\DLAgentInc
plutommi\mmi\EditorPen\EditorPenInc
plutommi\mtkapp\RightsMgr\RightsMgrInc
plutommi\MMI\UnifiedMMS\MMSBGSR\MMSBGSRInc
vendor\langlearn\app\inc
vendor\gis\mapbar\mmi\inc
plutommi\mmi\CertificateManager\CertificateManagerMMIInc
vendor\mercury_master\inc
