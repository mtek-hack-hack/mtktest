drv\include
inc
inc\hwdrv
interface\hwdrv

vendor\mercury_master\inc
vendor\mercury_master\inc\master_sdk_inc
vendor\mercury_master\inc\adapter_inc
custom\mercury\mercury_master\inc

custom\system\DAYO25_06B_BB
custom\system\DAYO28_06B_BB
plutommi\mmi\framework\commonfiles\commoninc
plutommi\mmi\Framework\Osl\OslInc
plutommi\mmi\framework\eventhandling\eventsinc
plutommi\mmi\datetime\datetimeinc
plutommi\mmi\miscframework\miscframeworkinc
plutommi\mtkapp\gdi\gdiinc
plutommi\mmi\Inc
plutommi\customer\customerinc
plutommi\mmi\inc\menuid
plutommi\mmi\framework\history\historyinc
plutommi\mmi\GUI\GUI_INC
plutommi\mmi\idlescreen\idlescreeninc
plutommi\mmi\profiles\profilesinc
plutommi\mmi\audio\audioinc
plutommi\mmi\setting\settinginc
plutommi\mmi\commonscreens\commonscreensinc
plutommi\MMI\SmartMessage\SmartMessageInc
plutommi\mmi\asyncevents\AsyncEventsInc
plutommi\mmi\Audio\AudioInc
plutommi\mmi\callmanagement\CommonFiles\CommonInc
plutommi\mmi\callmanagement\outgoingcallmanagement\outgoinginc
plutommi\mmi\callmanagement\incomingcallmanagement\incominginc
plutommi\mmi\GSMCallApplication\CommonFiles\CommonInc
plutommi\mmi\GSMCallApplication\IncomingCallManagement\IncomingInc
plutommi\mmi\GSMCallApplication\OutgoingCallManagement\OutgoingInc
plutommi\mmi\UCM\UCMInc
plutommi\mmi\Calls\CallsInc
plutommi\MMI\ChatApp\ChatAppInc
plutommi\mmi\Connect\ConnectInc
plutommi\Customer\custresource
plutommi\mmi\DateTime\DateTimeInc
plutommi\mmi\debuglevels\debuglevelInc
plutommi\mmi\EMS\EmsInc
plutommi\mmi\FontData
plutommi\mmi\framework\tasks\tasksinc
plutommi\mmi\framework\osl\oslInc
plutommi\mmi\framework\history\historyInc
plutommi\mmi\framework\EventHandling\EventsInc
plutommi\mmi\framework\MemManager\MemManagerInc
plutommi\mmi\framework\NVRAMManager\NVRAMManagerInc
plutommi\mmi\framework\ThemeManager\ThemeManagerInc
plutommi\mmi\FunAndGames\FunAndGamesInc
plutommi\mmi\gui\gui_inc
plutommi\MMI\IdleScreen\IdleScreenInc
plutommi\MMI\IdleScreen\IdleScreenInc\DemoAppInc
plutommi\mmi\inc
plutommi\mmi\inc\ImgID
plutommi\mmi\inc\MenuID
plutommi\mmi\inc\StringID
plutommi\mmi\MainMenu\MainMenuInc
plutommi\mmi\Messages\MessagesInc
plutommi\MMI\Messages
plutommi\mmi\miscframework\miscframeworkinc
plutommi\mmi\phonebook\PhonebookInc
plutommi\mmi\profiles\ProfilesInc
plutommi\mmi\sat\satInc
plutommi\mmi\Setting\SettingInc
plutommi\mmi\SSC\SSCInc
plutommi\MtkApp\MtkAppInc
plutommi\MtkApp\EngineerMode\EngineerModeInc
plutommi\MtkApp\SoundRecorder\SoundRecorderInc
plutommi\MtkApp\AudioPlayer\AudioPlayerInc
plutommi\MtkApp\ABRepeater\ABRepeaterInc
plutommi\MtkApp\FMRadio\FMRadioInc
plutommi\MtkApp\FMScheduleRec\FMScheduleRecInc
plutommi\MtkApp\Connectivity\ConnectivityInc
plutommi\MtkApp\Connectivity\ConnectivityInc\BtCommon
plutommi\MtkApp\Connectivity\ConnectivityInc\BtHandphone
plutommi\MtkApp\Connectivity\ConnectivityInc\BtBchs
plutommi\MtkApp\Connectivity\ConnectivityInc\BtMtk
plutommi\MMI\poweron\PoweronInc
plutommi\MMI\gpio\gpioInc
plutommi\MMI\DataAccount\DataAccountInc
plutommi\MMI\Framework\Osl\OslInc
plutommi\MMI\Help\HelpInc
plutommi\MMI\Organizer\OrganizerInc
plutommi\MMI\Extra\ExtraInc
plutommi\mmi\ATHandler\ATHandlerInc
vendor\InputMethod\T9\adaptation\include
vendor\InputMethod\ZI\adaptation\include
plutommi\mmi\NITZHandler\NITZInc
plutommi\MMI\Framework\FileSystem\FileSystemInc
MoDIS\FileSystem\FileSystemInc
plutommi\mmi\commonscreens\commonscreensInc
plutommi\mmi\CPHS\CPHSInc
plutommi\Customer\CustomerInc
plutommi\Customer\Customize
verno
plutommi\MtkApp\FileMgr\FileMgrInc
plutommi\MtkApp\Camera\CameraInc
plutommi\Mtkapp\Barcodereader\barcodereaderinc
plutommi\MtkApp\Video\VideoInc
plutommi\MtkApp\GDI\GDIInc
plutommi\MtkApp\MDI\MDIInc
plutommi\MtkApp\mmiapi\include
plutommi\MtkApp\vObjects\vObjectInc
plutommi\MtkApp\VRSD\VRSDInc
plutommi\MtkApp\VRSI\VRSIInc
plutommi\MtkApp\PhotoEditor\PhotoEditorInc
fmt\include
plutommi\MMI\Stopwatch\StopwatchInc
plutommi\MMI\EmailApp\EmailAppInc
wapadp\include
drm\include
plutommi\MMI\BIDI\BIDIInc
plutommi\MMI\IMPS\IMPSInc
ps\interfaces\local_inc
plutommi\MMI\PoC\PoCInc
applib\misc\include
applib\mem\include
plutommi\mmi\EditorPen\EditorPenInc
xmlp\include
drv\include
plutommi\MtkApp\BGSound\BGSoundInc
plutommi\MtkApp\JavaAgency\JavaAgencyInc
plutommi\VendorApp\DevApp\DevAppInc
vendor\dict\gv\adaptation\inc
vendor\dict\motech\adaptation\inc
vendor\dict\trilogy\adaptation\inc
plutommi\mmi\dictionary\DictInc
plutommi\mmi\EbookReader\EbookInc
plutommi\MMI\UnifiedMessage\UnifiedMessageInc
plutommi\MtkApp\DLAgent\DLAgentInc
plutommi\MMI\UnifiedComposer\UnifiedComposerInc
plutommi\MMI\VoIP\VoIPInc
plutommi\MMI\gpio\gpioInc
plutommi\MtkApp\MDI\MDIInc
plutommi\mmi\browserapp\browser\browserinc
plutommi\mmi\gui\oem_inc
plutommi\MtkApp\SyncML\SyncMLInc

config\include
