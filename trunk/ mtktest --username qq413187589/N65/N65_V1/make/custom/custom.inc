custom\system\UNIRISE25_GEMINI_BB
custom\common
custom\l1_rf\UNIRISE25_GEMINI_MT6139E
custom\ul1_rf\
custom\drv\LCD\UNIRISE25_GEMINI_LCM
custom\drv\misc_drv\UNIRISE25_GEMINI_BB
custom\app\UNIRISE25_GEMINI_BB
custom\ps\UNIRISE25_GEMINI_BB
custom\drv\misc_drv\UNIRISE25_GEMINI_BB\codegen
custom\drv\common_drv
custom\common\PLUTO_MMI
custom\audio\UNIRISE25_GEMINI_BB
custom\meta\UNIRISE25_GEMINI_BB
custom\drv\analog_tv\TLG1100
custom\drv\g_sensor
custom\drv\camera\UNIRISE25_GEMINI_BB
custom\drv\yuv_sensor
custom\drv\bluetooth\UNIRISE25_GEMINI_BB
l1audio
verno
drv\include
usb\include
drv\wifi\UNIRISE25_GEMINI_BB
wifi\wndrv\include\hal
wifi\wndrv\include\hal\mt5911
wifi\wndrv\include\mgmt
wifi\wndrv\include\os
wifi\wndrv\include
plutommi\MMI\PROFILES\ProfilesInc
plutommi\MMI\Inc
plutommi\MMI\GUI\GUI_INC
plutommi\MMI\IdleScreen\IdleScreenInc
plutommi\MMI\Framework\History\HistoryInc
plutommi\MMI\Framework\MemManager\MemManagerInc
plutommi\MMI\Framework\EventHandling\EventsInc
plutommi\MMI\Framework\OSL\OSLInc
plutommi\MMI\Framework\Tasks\TasksInc
plutommi\MMI\DateTime\DateTimeInc
plutommi\MMI\MiscFramework\MiscFrameworkInc
plutommi\MTKApp\MTKAppInc
plutommi\MTKApp\MDI\MDIInc
plutommi\MtkApp\EngineerMode\EngineerModeInc
plutommi\MMI\Setting\SettingInc
plutommi\MMI\Organizer\OrganizerInc
plutommi\MMI\Inc\ImgID
plutommi\MMI\Inc\MenuID
plutommi\MMI\Inc\StringID
plutommi\MMI\Audio\AudioInc
j2me\vm\IJET\adaptation\include
j2me\jal\include
bluetooth\inc\sys
bluetooth\inc
