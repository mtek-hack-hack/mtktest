vendor\InputMethod\zi\adaptation\include
lcmmi\mmi\asyncevents\AsyncEventsInc
lcmmi\mmi\Audio\AudioInc
lcmmi\mmi\PROFILES\ProfilesInc
lcmmi\mmi\callmanagement\CommonFiles\CommonInc
lcmmi\mmi\callmanagement\outgoingcallmanagement\outgoinginc
lcmmi\mmi\callmanagement\incomingcallmanagement\incominginc
lcmmi\mmi\Calls\CallsInc
lcmmi\mmi\Connect\ConnectInc
lcmmi\mmi\custresource
lcmmi\mmi\DateTime\DateTimeInc
lcmmi\mmi\debuglevels\debuglevelInc
lcmmi\mmi\EMS\EmsInc
lcmmi\mmi\FontData
lcmmi\mmi\framework\tasks\tasksinc
lcmmi\mmi\framework\osl\oslInc
lcmmi\mmi\framework\history\historyInc
lcmmi\mmi\framework\EventHandling\EventsInc
lcmmi\mmi\FunAndGames\FunAndGamesInc
lcmmi\mmi\gui\gui_inc
lcmmi\MMI\IdleScreen\IdleScreenInc
lcmmi\MMI\IdleScreen\IdleScreenInc\DemoAppInc\
lcmmi\mmi\inc
lcmmi\mmi\inc\ImgID
lcmmi\mmi\inc\MenuID
lcmmi\mmi\inc\StringID
lcmmi\mmi\MainMenu\MainMenuInc
lcmmi\mmi\Messages\MessagesInc
lcmmi\mmi\miscframework\miscframeworkinc
lcmmi\mmi\phonebook\PhonebookInc
lcmmi\mmi\sat\satInc
lcmmi\mmi\Setting\SettingInc
lcmmi\mmi\CommonScreens\CommonScreensInc
lcmmi\MtkApp\MtkAppInc
lcmmi\MtkApp\EngineerMode\EngineerModeInc
lcmmi\MtkApp\SoundRecorder\SoundRecorderInc
lcmmi
lcmmi\customer\customerinc
lcmmi\MtkApp\Camera\CameraInc
lcmmi\MtkApp\AudioPlayer\AudioPlayerInc
lcmmi\MtkApp\FileMgr\FileMgrInc
lcmmi\MtkApp\GDI\GDIInc
