; Copyright Statement:
; --------------------
; This software is protected by Copyright and the information contained
; herein is confidential. The software may not be copied and the information
; contained herein may not be used or disclosed except with the written
; permission of MediaTek Inc. (C) 2005
; 
; BY OPENING THIS FILE, BUYER HEREBY UNEQUIVOCALLY ACKNOWLEDGES AND AGREES
; THAT THE SOFTWARE/FIRMWARE AND ITS DOCUMENTATIONS ("MEDIATEK SOFTWARE")
; RECEIVED FROM MEDIATEK AND/OR ITS REPRESENTATIVES ARE PROVIDED TO BUYER ON
; AN "AS-IS" BASIS ONLY. MEDIATEK EXPRESSLY DISCLAIMS ANY AND ALL WARRANTIES,
; EXPRESS OR IMPLIED, INCLUDING BUT NOT LIMITED TO THE IMPLIED WARRANTIES OF
; MERCHANTABILITY, FITNESS FOR A PARTICULAR PURPOSE OR NONINFRINGEMENT.
; NEITHER DOES MEDIATEK PROVIDE ANY WARRANTY WHATSOEVER WITH RESPECT TO THE
; SOFTWARE OF ANY THIRD PARTY WHICH MAY BE USED BY, INCORPORATED IN, OR
; SUPPLIED WITH THE MEDIATEK SOFTWARE, AND BUYER AGREES TO LOOK ONLY TO SUCH
; THIRD PARTY FOR ANY WARRANTY CLAIM RELATING THERETO. MEDIATEK SHALL ALSO
; NOT BE RESPONSIBLE FOR ANY MEDIATEK SOFTWARE RELEASES MADE TO BUYER'S
; SPECIFICATION OR TO CONFORM TO A PARTICULAR STANDARD OR OPEN FORUM.
; 
; BUYER'S SOLE AND EXCLUSIVE REMEDY AND MEDIATEK'S ENTIRE AND CUMULATIVE
; LIABILITY WITH RESPECT TO THE MEDIATEK SOFTWARE RELEASED HEREUNDER WILL BE,
; AT MEDIATEK'S OPTION, TO REVISE OR REPLACE THE MEDIATEK SOFTWARE AT ISSUE,
; OR REFUND ANY SOFTWARE LICENSE FEES OR SERVICE CHARGE PAID BY BUYER TO
; MEDIATEK FOR SUCH MEDIATEK SOFTWARE AT ISSUE.
; 
; THE TRANSACTION CONTEMPLATED HEREUNDER SHALL BE CONSTRUED IN ACCORDANCE
; WITH THE LAWS OF THE STATE OF CALIFORNIA, USA, EXCLUDING ITS CONFLICT OF
; LAWS PRINCIPLES.  ANY DISPUTES, CONTROVERSIES OR CLAIMS ARISING THEREOF AND
; RELATED THERETO SHALL BE SETTLED BY ARBITRATION IN SAN FRANCISCO, CA, UNDER
; THE RULES OF THE INTERNATIONAL CHAMBER OF COMMERCE (ICC).

; NocodeCMMAutoGen v0.5 by Joe Wang

; specify_reset_func
SYStem.RESet
SYStem.CPU ARM9E
;SYStem.JtagClock 2000000.
SYStem.JtagClock RTCK.
sys.o cflush on
SYStem.Up
setup.IMASKHLL ON
setup.IMASKASM ON
; setting_EMI_and_watchdog

D.S SD:0x80010000 %LE %LONG 0x2040490a ; 10T RLT, 9T WST
D.S SD:0x80010008 %LE %LONG 0x2040490a ; 10T RLT, 9T WST
D.S SD:0x80010060 %LE %WORD 0x02       ; NOR-flash start
; bypass_CTIRQ1_precision_chk
; Avoiding assert at CTIRQ1/2
D.S SD:0x80220008 %LE %WORD 0xABCD
D.S SD:0x80220010 %LE %WORD 0x0001     ; bit0: disable CTIRQ1/2 timing check
; specify_load_elf
D.LOAD.ELF .\BUILD\UNIRISE25_GEMINI\UNIRISE25_GEMINI_PCB01_GPRS_MT6225_S00.elf /PATH . /nocode
; add_utility_for_debugging
task.config NUCLEUS
menu.reprogram NUCLEUS
; set_hw_breakpoint_by_def
; setting attribute of breakpoints
Break.Select Program OnChip
Break.Select Hll OnChip
Break.Select Spot OnChip
Break.Select Read OnChip
Break.Select Write OnChip
; specify_load_path
; set the path for source level debugging
y.spath .\custom\drv\LCD\UNIRISE25_GEMINI_LCM
y.spath .\NUCLEUS\src
y.spath .\init\src
y.spath .\kal\common\src
y.spath .\kal\NUCLEUS\src
y.spath .\adaptation\src
y.spath .\config\src
y.spath .\drv\src
y.spath .\mtkdebug
y.spath .\ps\init\src
y.spath .\stacklib\src
y.spath .\ps\flow_ctrl\src
y.spath .\l1\common
y.spath .\l1\l1a
y.spath .\l1\l1c
y.spath .\l1\l1d
y.spath .\l1sp
y.spath .\nvram\src
y.spath .\nvram\fd\src
y.spath .\mmi\src
y.spath .\smi\src
y.spath .\t9\src
y.spath .\ps\cc-ss\cc\src
y.spath .\ps\cc-ss\ss\src
y.spath .\ps\gen\sme_tt
y.spath .\ps\gprs-rr\src
y.spath .\ps\l4\csm
y.spath .\ps\l4\csm\cc\src
y.spath .\ps\l4\csm\ss\src
y.spath .\ps\l4\l4a\src
y.spath .\ps\l4\l4c\src
y.spath .\ps\l4\phb\src
y.spath .\ps\l4\rac\src
y.spath .\ps\l4\smsal\src
y.spath .\ps\l4\smu\src
y.spath .\ps\l4\src
y.spath .\ps\l4\uem\src
y.spath .\ps\mm\cmm\src
y.spath .\ps\mm\common\src
y.spath .\ps\sim\src
y.spath .\ps\sms\src
y.spath .\ps\tools\asn1lib\src
y.spath .\ps\tools\asn1lib\ber\src
; clean_win_and_endup
winclear
d.l
enddo
